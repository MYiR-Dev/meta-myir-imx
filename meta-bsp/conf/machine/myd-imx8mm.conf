## meta-bsp/conf/machine/myd-imx8mm.conf
```bitbake
#@TYPE: Machine
#@NAME: MYiR MYD-i.MX8MM 
#@SOC: i.MX8MM
#@DESCRIPTION: Machine configuration for MYiR i.MX8M mini DDR4
#@MAINTAINER: alex <fan.hu@myirtech.com>

MACHINEOVERRIDES =. "mx8:mx8m:mx8mm:"

MACHINENAME= "myd-imx8mm"
require conf/machine/include/imx-base.inc
require conf/machine/include/tune-cortexa53.inc

MACHINE_FEATURES += " pci wifi bluetooth optee ap6212 "
# MACHINE_FIRMWARE_append = " linux-firmware-ap6212"
MACHINE_FIRMWARE_append = " ${@bb.utils.contains('MACHINE_FEATURES', 'ap6212', 'linux-firmware-ap6212', '', d)}"

KERNEL_DEVICETREE = "myir/myb-imx8mm-base.dtb  myir/myb-imx8mm-lcd-atk-10-1.dtb "
KERNEL_DEVICETREE += "myir/myb-imx8mm-lcd-hontron-7.dtb "
KERNEL_DEVICETREE += "myir/myb-imx8mm-lcd-me190etn01.dtb "
KERNEL_DEVICETREE += "myir/myb-imx8mm-rpmsg-m4.dtb "

WKS_FILE_DEPENDS_mx8 += "imx-m4-demos"
IMAGE_BOOT_FILES += "imx8mm_m4_TCM_hello_world.bin \
                    imx8mm_m4_TCM_rpmsg_lite_pingpong_rtos_linux_remote.bin \
                    imx8mm_m4_TCM_rpmsg_lite_str_echo_rtos.bin \
                    imx8mm_m4_TCM_sai_low_power_audio.bin \
"

UBOOT_CONFIG ??= "sd"
UBOOT_CONFIG ??= "fspi"
UBOOT_CONFIG[sd] = "myd_imx8mm_defconfig,sdcard"
UBOOT_CONFIG[fspi] = "myd_imx8mm_qspi_defconfig,fspi"


SPL_BINARY = "spl/u-boot-spl.bin"

# Set DDR FIRMWARE
DDR_FIRMWARE_NAME = "ddr4_imem_1d.bin ddr4_dmem_1d.bin ddr4_imem_2d.bin ddr4_dmem_2d.bin"

# Set u-boot DTB
UBOOT_DTB_NAME = "myb-imx8mm-base.dtb"


# Set imx-mkimage boot target
IMXBOOT_TARGETS = "flash_ddr4_evk"
IMXBOOT_TARGETS += "${@bb.utils.contains('UBOOT_CONFIG', 'fspi', 'flash_ddr4_evk_flexspi', 'flash_ddr4_evk', d)}"

SERIAL_CONSOLES = "115200;ttymxc1"

IMAGE_BOOTLOADER = "imx-boot"

LOADADDR = ""
IMX_BOOT_SEEK = "33"


# set imx-boot dtb name 
IMX_BOOT_DTB_NAME="fsl-imx8mm-ddr4-evk.dtb"

# Set Kernel Config
KERNEL_CONFIG_FILE = "myd_imx8mm_defconfig"
```

## meta-bsp/conf/machine/myd-jx8mm.conf
```bitbake
#@TYPE: Machine
#@NAME: NXP i.MX8MM LPDDR4 Evaluation Kit
#@SOC: i.MX8MM
#@DESCRIPTION: Machine configuration for NXP i.MX8MMini LPDDR4 EVK
#@MAINTAINER: Jun Zhu <junzhu@nxp.com>

MACHINEOVERRIDES =. "mx8:mx8m:mx8mm:"

MACHINENAME= "myd-jx8mm"
require conf/machine/include/imx-base.inc
require conf/machine/include/tune-cortexa53.inc

MACHINE_FEATURES += " pci wifi bluetooth optee ap6212 "
MACHINE_FIRMWARE_append = " ${@bb.utils.contains('MACHINE_FEATURES', 'ap6212', 'linux-firmware-ap6212', '', d)}"

KERNEL_DEVICETREE = "myir/myb-jx8mm-base.dtb  myir/myb-jx8mm-lvds-atk10-1.dtb "



WKS_FILE_DEPENDS_mx8 += "imx-m4-demos"
IMAGE_BOOT_FILES += "imx8mm_m4_TCM_hello_world.bin \
                    imx8mm_m4_TCM_rpmsg_lite_pingpong_rtos_linux_remote.bin \
                    imx8mm_m4_TCM_rpmsg_lite_str_echo_rtos.bin \
                    imx8mm_m4_TCM_sai_low_power_audio.bin \
"

UBOOT_CONFIG ??= "sd"
#UBOOT_CONFIG[sd] = "imx8mm_evk_config,sdcard"
UBOOT_CONFIG[sd] = "myd_jx8mm_defconfig,sdcard"
#UBOOT_CONFIG[fspi] = "imx8mm_evk_fspi_defconfig"
SPL_BINARY = "spl/u-boot-spl.bin"

# Set DDR FIRMWARE
DDR_FIRMWARE_NAME = "lpddr4_pmu_train_1d_imem.bin lpddr4_pmu_train_1d_dmem.bin lpddr4_pmu_train_2d_imem.bin lpddr4_pmu_train_2d_dmem.bin"

# Set u-boot DTB
UBOOT_DTB_NAME = "myb-jx8mm-base.dtb"

# Set imx-mkimage boot target
IMXBOOT_TARGETS = "${@bb.utils.contains('UBOOT_CONFIG', 'fspi', 'flash_evk_flexspi', 'flash_evk', d)}"

SERIAL_CONSOLES = "115200;ttymxc1"

IMAGE_BOOTLOADER = "imx-boot"

LOADADDR = ""
IMX_BOOT_SEEK = "33"


# set imx-boot dtb name 
IMX_BOOT_DTB_NAME="fsl-imx8mm-evk.dtb"
#
# Set Kernel Config
KERNEL_CONFIG_FILE = "myd_jx8mm_defconfig"
```

## meta-bsp/conf/machine/myd-jx8mma7.conf
```bitbake
MACHINEOVERRIDES =. "imx-boot-container:mx8:mx8m:mx8mm:"

require conf/machine/include/imx-base.inc
require conf/machine/include/tune-cortexa53.inc

#MACHINE_FEATURES += "pci wifi bluetooth bcm43455 bcm4356"
MACHINE_FEATURES += "pci wifi bluetooth ap6212"
MACHINE_FIRMWARE_append = " ${@bb.utils.contains('MACHINE_FEATURES', 'ap6212', 'linux-firmware-ap6212', '', d)}"
# NXP BSP can consume proprietary jailhouse and BCM4359 firmware
# Since the firmware is not available publicly, and rather distributed
# under "Proprietary" license - we opt-out from using it in all BSPs
# and pin it to NXP BSP only
# OP-TEE is also applicable to NXP BSP, mainline BSP seems not to have
# a full support for it yet.
MACHINE_FEATURES:append:use-nxp-bsp = " optee jailhouse bcm4359"

# The device tree name is implicit for LPDDR4, so can't use MACHINE here
KERNEL_DEVICETREE_BASENAME = "myd-jx8mma7"
MACHINENAME= "myd-jx8mma7"
#KERNEL_DEVICETREE_append_use-nxp-bsp = " \
#        freescale/${KERNEL_DEVICETREE_BASENAME}-usd-wifi.dtb \
#"


#UBOOT_CONFIG_BASENAME = "imx8mm_evk"
UBOOT_CONFIG_BASENAME = "myd_jx8mma7"
UBOOT_CONFIG[fspi] = "${UBOOT_CONFIG_BASENAME}_fspi_defconfig"

DDR_FIRMWARE_NAME = " \
        lpddr4_pmu_train_1d_imem.bin \
        lpddr4_pmu_train_1d_dmem.bin \
        lpddr4_pmu_train_2d_imem.bin \
        lpddr4_pmu_train_2d_dmem.bin \
"

IMXBOOT_TARGETS_BASENAME = "flash_evk"

KERNEL_DEVICETREE = " \
    myir/${KERNEL_DEVICETREE_BASENAME}-lvds-atk10-1.dtb \
    myir/${KERNEL_DEVICETREE_BASENAME}-rpmsg.dtb      \
"
UBOOT_DTB_NAME = "${KERNEL_DEVICETREE_BASENAME}-base.dtb"

IMX_DEFAULT_BOOTLOADER_use-nxp-bsp = "u-boot-imx"
IMX_DEFAULT_BOOTLOADER_use-mainline-bsp = "u-boot-fslc"

#WKS_FILE_DEPENDS_append = " imx-m4-demos"
WKS_FILE_DEPENDS_mx8 += "imx-m4-demos"
IMAGE_BOOT_FILES += "imx8mm_m4_TCM_hello_world.bin \
                    imx8mm_m4_TCM_rpmsg_lite_pingpong_rtos_linux_remote.bin \
                    imx8mm_m4_TCM_rpmsg_lite_str_echo_rtos.bin \
                    imx8mm_m4_TCM_sai_low_power_audio.bin \
"
UBOOT_SUFFIX = "bin"

UBOOT_CONFIG ??= "sd"
UBOOT_CONFIG[sd]       = "${UBOOT_CONFIG_BASENAME}_defconfig,sdcard"
UBOOT_CONFIG[mfgtool]  = "${UBOOT_CONFIG_BASENAME}_defconfig"
#UBOOT_CONFIG_pn-u-boot-imx ?= "${UBOOT_CONFIG_BASENAME}_defconfig"
SPL_BINARY = "spl/u-boot-spl.bin"

ATF_PLATFORM = "imx8mm"
ATF_LOAD_ADDR = "0x920000"

# Extra firmware package name, that is required to build boot container for fslc bsp
IMX_EXTRA_FIRMWARE = "firmware-imx-8m"

IMXBOOT_TARGETS = "${@bb.utils.contains('UBOOT_CONFIG', 'fspi', '${IMXBOOT_TARGETS_BASENAME}_flexspi', '${IMXBOOT_TARGETS_BASENAME}', d)}"

IMX_BOOT_SOC_TARGET = "iMX8MM"

SERIAL_CONSOLES = "115200;ttymxc1"

LOADADDR = ""
UBOOT_SUFFIX = "bin"
UBOOT_MAKE_TARGET = "all"
IMX_BOOT_SEEK = "33"

OPTEE_BIN_EXT = "8mm"
TEE_LOAD_ADDR = "0xbe000000"

# Add additional firmware
MACHINE_FIRMWARE_append = " linux-firmware-ath10k"
```

## meta-bsp/conf/machine/myd-jx8mp.conf
```bitbake
#@TYPE: Machine
#@NAME:  MYIR MYD-JX8MP Kit
#@SOC: i.MX8MP
#@DESCRIPTION: Machine configuration for MYIR i.MX8MP EVK
#@MAINTAINER: coin du <coin.du@myirtech.com>

MACHINEOVERRIDES =. "mx8:mx8m:mx8mp:"

MACHINENAME= "myd-jx8mp"
require conf/machine/include/imx-base.inc
require conf/machine/include/tune-cortexa53.inc

MACHINE_FEATURES += " pci wifi bluetooth optee bcm43430"

KERNEL_DEVICETREE = " \
                     myir/myd-jx8mp-base.dtb \
                     myir/myd-jx8mp-lt8912.dtb \
                     myir/myd-jx8mp-atk-10.dtb \
                     myir/myd-jx8mp-hontron-7.dtb \
                     myir/myd-jx8mp-m190etn01-19.dtb \
"


WKS_FILE_DEPENDS_append = " imx-m7-demos"
IMAGE_BOOT_FILES += "imx8mp_m7_TCM_hello_world.bin \
                    imx8mp_m7_TCM_rpmsg_lite_pingpong_rtos_linux_remote.bin \
                    imx8mp_m7_TCM_rpmsg_lite_str_echo_rtos.bin \
                    imx8mp_m7_TCM_sai_low_power_audio.bin \
"

UBOOT_CONFIG ??= "sd"
UBOOT_CONFIG[sd] = "myd_jx8mp_defconfig,sdcard"
UBOOT_CONFIG[fspi] = "myd_jx8mp_defconfig"
UBOOT_CONFIG[ecc] = "imx8mp_evk_inline_ecc_defconfig"
UBOOT_CONFIG[mfgtool] = "myd_jx8mp_defconfig"
SPL_BINARY = "spl/u-boot-spl.bin"

# Set DDR FIRMWARE
DDR_FIRMWARE_NAME = "lpddr4_pmu_train_1d_dmem_202006.bin lpddr4_pmu_train_1d_imem_202006.bin lpddr4_pmu_train_2d_dmem_202006.bin lpddr4_pmu_train_2d_imem_202006.bin"

# Set u-boot DTB
UBOOT_DTB_NAME = "myd-jx8mp-base.dtb"

# Set imx-mkimage boot target
IMXBOOT_TARGETS = "${@bb.utils.contains('UBOOT_CONFIG', 'fspi', 'flash_evk_flexspi', 'flash_evk', d)}"

# Set Serial console
SERIAL_CONSOLES = "115200;ttymxc1"

IMAGE_BOOTLOADER = "imx-boot"

LOADADDR = ""
UBOOT_SUFFIX = "bin"
UBOOT_MAKE_TARGET = ""
IMX_BOOT_SEEK = "32"

OPTEE_BIN_EXT = "8mp"

# Add additional firmware
MACHINE_FIRMWARE_append = " linux-firmware-ath10k "



# set imx-boot dtb name 
IMX_BOOT_DTB_NAME="imx8mp-evk.dtb"

# Set Kernel Config
KERNEL_CONFIG_FILE="myd_jx8mp_defconfig"
IMX_KERNEL_CONFIG_AARCH64="myd_jx8mp_defconfig"
```

## meta-bsp/conf/machine/myd-jx8mx.conf
```bitbake
#@TYPE: Machine
#@NAME:  MYIR MYD-JX8MX Kit
#@SOC: i.MX8MX
#@DESCRIPTION: Machine configuration for MYIR i.MX8MX EVK
#@MAINTAINER: coin du <coin.du@myirtech.com>

MACHINEOVERRIDES =. "mx8:mx8m:mx8mq:"

MACHINENAME= "myd-jx8mx"
require conf/machine/include/imx-base.inc
require conf/machine/include/arm/arch-arm64.inc

MACHINE_FEATURES += "pci wifi bluetooth optee "

MACHINE_SOCARCH_FILTER_append_mx8mq = " virtual/libopenvg virtual/libgles1 virtual/libgles2 virtual/egl virtual/mesa virtual/libgl virtual/libg2d"

KERNEL_DEVICETREE = " \
			myir/myd-jx8mx-base.dtb \
			myir/myd-jx8mx-lcdif-atk-10-1.dtb \
			myir/myd-jx8mx-dual-atk-10-1.dtb \
			myir/myd-jx8mx-lcdif-hontron-7.dtb \
			myir/myd-jx8mx-dual-hontron-7.dtb \
                     "

UBOOT_CONFIG ??= "sd"
UBOOT_CONFIG[sd] = "myd_jx8mx_defconfig,sdcard"
UBOOT_CONFIG[mfgtool] = "myd_jx8mx_defconfig"
SPL_BINARY = "spl/u-boot-spl.bin"

# Set DDR FIRMWARE
DDR_FIRMWARE_NAME = "lpddr4_pmu_train_1d_imem.bin lpddr4_pmu_train_1d_dmem.bin lpddr4_pmu_train_2d_imem.bin lpddr4_pmu_train_2d_dmem.bin"

# Set u-boot DTB
UBOOT_DTB_NAME = "myd-jx8mx-base.dtb"

# Set imx-mkimage boot target
IMXBOOT_TARGETS = "flash_evk flash_evk_no_hdmi flash_dp_evk"

# Set Serial console
SERIAL_CONSOLES = "115200;ttymxc0"

IMAGE_BOOTLOADER = "imx-boot"

LOADADDR = ""
UBOOT_SUFFIX = "bin"
UBOOT_MAKE_TARGET = ""
IMX_BOOT_SEEK = "33"

OPTEE_BIN_EXT = "8mq"

# Add additional firmware
MACHINE_FIRMWARE_append = " linux-firmware-ath10k"

# Use gstreamer 1.14 from meta-freescale
PREFERRED_VERSION_gstreamer1.0 ?= "1.14.imx"
PREFERRED_VERSION_gstreamer1.0-plugins-base ?= "1.14.imx"
PREFERRED_VERSION_gstreamer1.0-plugins-good ?= "1.14.imx"
PREFERRED_VERSION_gstreamer1.0-plugins-bad ?= "1.14.imx"
PREFERRED_VERSION_gstreamer1.0-libav ?= "1.14.0"


# set imx-boot dtb name 
IMX_BOOT_DTB_NAME="fsl-imx8mq-evk.dtb"

# Set Kernel Config
KERNEL_CONFIG_FILE = "myd_jx8mx_defconfig"
```

## meta-bsp/conf/machine/mys-6ull.conf
```bitbake
#@TYPE: Machine
#@NAME: MYiR MYS-6ULL 14X14
#@SOC: i.MX6ULL
#@DESCRIPTION: Machine configuration for NXP i.MX6ULL 14x14 EVK
#@MAINTAINER: Mazel Li <mazel.li@myirtech.com>

MACHINEOVERRIDES =. "mx6:mx6ul:mx6ull:"

MACHINENAME= "mys-6ull"
include conf/machine/include/imx-base.inc
include conf/machine/include/tune-cortexa7.inc

MACHINE_FIRMWARE_append_mx6 = " linux-firmware-imx-sdma-imx6q"

KERNEL_DEVICETREE = "mys-6ull-14x14-emmc.dtb \
                     mys-6ull-14x14-gpmi-weim.dtb"

UBOOT_CONFIG ??= "${@bb.utils.contains('MACHINE_FEATURES', 'optee', 'sd-optee', 'sd', d)}"
UBOOT_CONFIG ??= "nand emmc sd"
UBOOT_CONFIG[sd] = "mys_imx6ull_emmc_ddr512_defconfig,sdcard"
UBOOT_CONFIG[emmc] = "mys_imx6ull_emmc_ddr512_defconfig,sdcard"
UBOOT_CONFIG[nand] = "mys_imx6ull_nand_ddr256_defconfig,ubifs"
#UBOOT_CONFIG[qspi1] = "mx6ull_14x14_evk_qspi1_config"
#UBOOT_CONFIG[mfgtool] = "mx6ull_14x14_evk_config"
UBOOT_CONFIG[sd-optee] = "mys_imx6ull_emmc_ddr512_defconfig,sdcard"

OPTEE_BIN_EXT = "6ullevk"

MACHINE_FEATURES += "wifi bluetooth optee bcm4339 bcm43455"

# Add kernel modules
MACHINE_EXTRA_RRECOMMENDS += "\
    kernel-module-rtl8188fu \
"
```

## meta-bsp/conf/machine/mys-8mmx.conf
```bitbake
#@TYPE: Machine
#@NAME: MYIR MYS-8MMX Kit
#@SOC: i.MX8MM
#@DESCRIPTION: Machine configuration for MYIR i.MX8MMini DDR4 EVK
#@MAINTAINER: coin du <coin.du@myirtech.com>

MACHINEOVERRIDES =. "mx8:mx8m:mx8mm:"

MACHINENAME= "mys-8mmx"
require conf/machine/include/imx-base.inc
require conf/machine/include/tune-cortexa53.inc

MACHINE_FEATURES += " pci wifi bluetooth optee ap6212"

KERNEL_DEVICETREE = "freescale/mys-imx8mm-evk.dtb freescale/mys-imx8mm-lt8912-atk-10-1.dtb"
KERNEL_DEVICETREE += "freescale/mys-imx8mm-lt8912-hontron-7.dtb freescale/mys-imx8mm-evk-rpmsg.dtb"

WKS_FILE_DEPENDS_mx8 += "imx-m4-demos"
IMAGE_BOOT_FILES += "imx8mm_m4_TCM_hello_world.bin \
                    imx8mm_m4_TCM_rpmsg_lite_pingpong_rtos_linux_remote.bin \
                    imx8mm_m4_TCM_rpmsg_lite_str_echo_rtos.bin \
                    imx8mm_m4_TCM_sai_low_power_audio.bin \
"

UBOOT_CONFIG ??= "sd"
UBOOT_CONFIG[sd] = "mys_iot_imx8mm_ddr4_evk_defconfig,sdcard"


SPL_BINARY = "spl/u-boot-spl.bin"

# Set DDR FIRMWARE
DDR_FIRMWARE_NAME = "ddr4_imem_1d.bin ddr4_dmem_1d.bin ddr4_imem_2d.bin ddr4_dmem_2d.bin"

# Set u-boot DTB
UBOOT_DTB_NAME = "mys-iot-imx8mm-ddr4-evk.dtb"

# Set imx-mkimage boot target
IMXBOOT_TARGETS = "flash_ddr4_evk"

SERIAL_CONSOLES = "115200;ttymxc1"

IMAGE_BOOTLOADER = "imx-boot"

LOADADDR = ""
IMX_BOOT_SEEK = "33"


# set imx-boot dtb name 
IMX_BOOT_DTB_NAME="fsl-imx8mm-ddr4-evk.dtb"

# Set Kernel Config
KERNEL_CONFIG_FILE = "mys_iot_defconfig"
```
