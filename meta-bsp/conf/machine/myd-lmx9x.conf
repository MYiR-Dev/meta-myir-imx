## meta-myir-bsp/conf/machine/include/myir-imx93-evk.inc
```bitbake
MACHINEOVERRIDES =. "mx93:"

require conf/machine/include/imx-base.inc
require conf/machine/include/arm/armv8-2a/tune-cortexa55.inc

MACHINE_FEATURES += "pci wifi "
MACHINE_FEATURES:append:use-nxp-bsp = " optee jailhouse  dpdk "

MACHINE_FIRMWARE:append:use-nxp-bsp = " "

KERNEL_DEVICETREE = " \
    myir/${KERNEL_DEVICETREE_BASENAME}.dtb \
"
UBOOT_DTB_NAME = "${KERNEL_DEVICETREE_BASENAME}.dtb"

IMX_DEFAULT_BOOTLOADER:use-nxp-bsp = "u-boot-imx"
IMX_DEFAULT_BOOTLOADER:use-mainline-bsp = "u-boot-fslc"

LOADADDR = ""
UBOOT_SUFFIX = "bin"
UBOOT_MAKE_TARGET = ""

SPL_BINARY = "spl/u-boot-spl.bin"


# Set ATF platform name
ATF_PLATFORM = "imx93"



UBOOT_CONFIG[sd_1g]      = "myd_lmx93x_11x11_defconfig,sdcard"
#UBOOT_CONFIG[sd_1g]      = "myd_lmx93x_11x11_1g_defconfig,sdcard"
UBOOT_CONFIG[sd_2g]      = "myd_lmx93x_11x11_2g_defconfig,sdcard"

IMXBOOT_TARGETS = \
    "${@bb.utils.contains('UBOOT_CONFIG',   'sd', '${IMXBOOT_TARGETS_SD}', \
    		bb.utils.contains('UBOOT_CONFIG',  'sd_1g', '${IMXBOOT_TARGETS_SD}', \
    		bb.utils.contains('UBOOT_CONFIG',  'sd_2g', '${IMXBOOT_TARGETS_SD}', \
        bb.utils.contains('UBOOT_CONFIG',  'ecc', '${IMXBOOT_TARGETS_ECC}', \
        bb.utils.contains('UBOOT_CONFIG', 'fspi', '${IMXBOOT_TARGETS_FSPI}', \
                                                  'INVALID', d),d),d), d), d)}"
# Note different SD targets for different Glitch Detection (GDET) modes:
# | Target                     | Glitch Detection                                 |
# | flash_singleboot           | None                                             |
# | flash_singleboot_gdet      | Enabled                                          |
# | flash_singleboot_gdet_auto | Enabled during EdgeLock Secure Enclave API calls |
IMXBOOT_TARGETS_SD   = "flash_singleboot flash_singleboot_gdet flash_singleboot_gdet_auto"
IMXBOOT_TARGETS_ECC  = "flash_singleboot"
IMXBOOT_TARGETS_FSPI = "flash_singleboot_flexspi"

IMX_BOOT_SOC_TARGET = "iMX9"
IMX_BOOT_SEEK = "32"

# We have to disable SERIAL_CONSOLE due to auto-serial-console
SERIAL_CONSOLES = "115200;ttyLP0"

IMX_DEFAULT_BSP = "nxp"
```

## meta-myir-bsp/conf/machine/myd-jmx95-15x15-lpddr5.conf
```bitbake
#@TYPE: Machine
#@NAME: MYD-JMX95 15x15 Evaluation Kit with LPDDR5
#@SOC: i.MX95
#@DESCRIPTION: Machine configuration for NXP i.MX 95 15x15 EVK with LPDDR5
#@MAINTAINER: Mazel Li <Mazel.li@myir.cn>

MACHINEOVERRIDES =. "mx95:"

require conf/machine/include/myir-imx95.inc

#MACHINE_FEATURES:append:use-nxp-bsp = " hailo"

IMX_KERNEL_CONFIG_AARCH64 = "myd_jmx95_15x15_defconfig"

KERNEL_DEVICETREE_BASENAME = "myd-jmx95-15x15"

KERNEL_DEVICETREE:append:use-nxp-bsp = " \
    myir/myd-jmx95-15x15.dtb \
    myir/myd-jmx95-15x15-lvds-dual.dtb \
    myir/myd-jmx95-15x15-dsi-mipi101c.dtb \
    myir/myd-jmx95-15x15-lvds0-lvds1-ov5640.dtb \
    myir/myd-jmx95-15x15-lt9611-lvds1-ov5640.dtb \
    myir/myd-jmx95-15x15-4k-lt9611-lvds1-ov5640.dtb \
"

UBOOT_CONFIG_BASENAME = "myd_jmx95_15x15"

IMXBOOT_TARGETS_BASENAME = "flash"

OEI_BOARD  = "mx95lp5-4g-15"
DDR_TYPE   = "lpddr5"
DDR_FIRMWARE_NAME = " \
    lpddr5_dmem_v202409.bin \
    lpddr5_dmem_qb_v202409.bin \
    lpddr5_imem_v202409.bin \
    lpddr5_imem_qb_v202409.bin \
"
OEI_DDR_CONFIG     = "MIMX95_LPDDR5_EVK_15X15_4266MTS_FW2024.09_timing"
OEI_DDR_CONFIG_ECC = "MIMX95_LPDDR5_EVK_15X15_4266MTS_FW2024.09_ECC_enabled_timing"

# rutabaga-gfx: Rust/crosvm virtual GPU, fragile crate build
# Only QEMU uses it, remove globally for this machine
PACKAGECONFIG:remove = "rutabaga-gfx"
IMAGE_FSTYPES:append = " ext4"
M4_DEFAULT_IMAGE_MX95 = "imx95-15x15-evk_m7_TCM_power_mode_switch.bin"

#DISTRO_FEATURES:append = " sec_boot"
MYIR_AHAB_ENABLE = "${@bb.utils.contains('DISTRO_FEATURES', 'sec_boot', '1', '0', d)}"
MYIR_AHAB_CST_DIR = "${TOPDIR}/keys/cst"
MYIR_AHAB_CST_SRK_INDEX = "1"
#INHERIT += "${@bb.utils.contains('DISTRO_FEATURES', 'sec_boot', 'myir-boot-signed', '', d)}"
#UBOOT_SIGN_ENABLE = "0"
DUAL_ROOTFS = "${@bb.utils.contains('DISTRO_FEATURES', 'sec_boot', 'dual', '', d)}"
SIGNED_BOOT = "${@bb.utils.contains('DISTRO_FEATURES', 'sec_boot', 'signed', '', d)}"

SECURE_BOOT_FILES = " \
    os_cntr_signed.bin \
    os_cntr_signed_4k-lt9611-lvds1-ov5640.bin \
    os_cntr_signed_dsi-mipi101c.bin \
    os_cntr_signed_lt9611-lvds1-ov5640.bin \
    os_cntr_signed_lvds0-lvds1-ov5640.bin \
    os_cntr_signed_lvds-dual.bin \
"

IMAGE_BOOT_FILES:append = " \
${@bb.utils.contains('MYIR_FITIMAGE_BOOT', '1', '', bb.utils.contains('DISTRO_FEATURES', 'sec_boot', '${SECURE_BOOT_FILES}', '', d), d)} \
"
IMAGE_BOOT_FILES:remove = " \
${@bb.utils.contains('MYIR_FITIMAGE_BOOT', '1', '', bb.utils.contains('DISTRO_FEATURES', 'sec_boot', 'Image', '', d), d)} \
"

IMAGE_BOOT_FILES:append = " \
    mcore-demos/imx95-15x15-evk_m7_TCM_power_mode_switch.bin \
    mcore-demos/imx95-15x15-evk_m7_TCM_rpmsg_lite_pingpong_rtos_linux_remote.bin \
    mcore-demos/imx95-15x15-evk_m7_TCM_rpmsg_lite_str_echo_rtos.bin \
    mcore-demos/imx95-15x15-evk_m7_TCM_sai_low_power_audio.bin \
"


MACHINE_FEATURES:remove = " xen"
# Set time zone
DEFAULT_TIMEZONE = "Asia/Shanghai"

# ============================================================
#  dm-verity + fitImage + overlayfs
# ============================================================

ENABLE_DM_VERITY      ?= "0"
ENABLE_OVERLAYFS      ?= "0"
ENABLE_ROOTHASH_SIGN  ?= "0"
MYIR_FITIMAGE_BOOT    ?= "0"

# ======== dm-verity ========
#INHERIT += "${@bb.utils.contains('ENABLE_DM_VERITY', '1', 'myir-dmverity', '', d)}"
DM_VERITY_IMAGE ?= "${@bb.utils.contains('ENABLE_DM_VERITY', '1', 'myir-image-emmc', '', d)}"
DM_VERITY_IMAGE_TYPE    = "ext4"
DM_VERITY_SEPARATE_HASH = "0"

# ======== fitImage + initramfs ========
KERNEL_CLASSES:append        = "${@bb.utils.contains('MYIR_FITIMAGE_BOOT', '1', ' kernel-fitimage', '', d)}"
KERNEL_IMAGETYPE:forcevariable = "${@bb.utils.contains('MYIR_FITIMAGE_BOOT', '1', 'fitImage', 'Image', d)}"
KERNEL_IMAGETYPE_REPLACEMENT   = "${@bb.utils.contains('MYIR_FITIMAGE_BOOT', '1', 'Image', '', d)}"
KERNEL_IMAGE_NAME:prepend    = "${@bb.utils.contains('ENABLE_DM_VERITY', '1', '${INITRAMFS_IMAGE_NAME}-', '', d)}"
INITRAMFS_IMAGE         = "${@bb.utils.contains('ENABLE_DM_VERITY', '1', 'myir-initramfs-dmverity', '', d)}"
INITRAMFS_IMAGE_BUNDLE  = "${@bb.utils.contains('ENABLE_DM_VERITY', '1', '0', '', d)}"
ENABLE_FITIMAGE_SIGN      = "${MYIR_FITIMAGE_BOOT}"

# ======== overlayfs ========
MYIR_DM_VERITY_OVERLAY       = "${ENABLE_OVERLAYFS}"
MYIR_OVERLAY_PARTITION_SIZE  = "2048"

# ======== root hash ========
MYIR_DM_VERITY_SIGN_ROOTHASH = "${ENABLE_ROOTHASH_SIGN}"

# ======== FIT ========
UBOOT_SIGN_ENABLE      = "${ENABLE_FITIMAGE_SIGN}"
UBOOT_SIGN_ENABLE:pn-imx-boot = "0"
FIT_GENERATE_KEYS      = "${ENABLE_FITIMAGE_SIGN}"
UBOOT_SIGN_KEYDIR      = "${@bb.utils.contains('ENABLE_FITIMAGE_SIGN', '1', '${TOPDIR}/keys/fit', '', d)}"
UBOOT_SIGN_KEYNAME     = "${@bb.utils.contains('ENABLE_FITIMAGE_SIGN', '1', 'dev', '', d)}"
UBOOT_SIGN_IMG_KEYNAME = "${@bb.utils.contains('ENABLE_FITIMAGE_SIGN', '1', 'dev2', '', d)}"

# ======== WIC  ========
#WKS_FILE = "${@bb.utils.contains('ENABLE_DM_VERITY', '1', 'myd-jmx95-15x15-lpddr5-dmverity-overlay.wks.in', 'xxx.wks.in', d)}"
# ENABLE_DM_VERITY=1
INHERIT += "${@bb.utils.contains('ENABLE_DM_VERITY', '1', 'myir-boot-signed myir-dmverity', bb.utils.contains('DISTRO_FEATURES', 'sec_boot', 'myir-boot-signed', '', d), d)}"

UBOOT_ENTRYPOINT:mx95-generic-bsp = "${@bb.utils.contains('ENABLE_DM_VERITY', '1', '0x94000000', '', d)}"


#MYIR_OPTEE_STORAGE = "rpmb"
#MYIR_RPMB_MODE = "test"
OVERRIDES:append = "${@':dm-verity' if d.getVar('ENABLE_DM_VERITY') == '1' else ''}"

MYIR_OPTEE_STORAGE:dm-verity = "rpmb"
MYIR_RPMB_MODE:dm-verity = "test"
```

## meta-myir-bsp/conf/machine/myd-lmx91.conf
```bitbake
#@TYPE: Machine
#@NAME: NXP i.MX 91 11x11 Evaluation Kit with LPDDR4
#@SOC: i.MX91
#@DESCRIPTION: Machine configuration for NXP i.MX 91 11x11 EVK with LPDDR4
#@MAINTAINER: Jun Zhu <junzhu@nxp.com>

MACHINEOVERRIDES =. "mx91:"
MACHINENAME= "myd-lmx91"

require conf/machine/include/imx91-evk.inc

KERNEL_DEVICETREE:append:use-nxp-bsp = " \
	myir/myd-imx91-11x11.dtb  \
	myir/myd-imx91-11x11-RGB.dtb  \
"

UBOOT_CONFIG_BASENAME = "myd_imx91_11x11"

UBOOT_CONFIG[nand] = "${UBOOT_CONFIG_BASENAME}_spinand_defconfig"
UBOOT_CONFIG[fspi] = "${UBOOT_CONFIG_BASENAME}_defconfig"
UBOOT_CONFIG[ecc] = "${UBOOT_CONFIG_BASENAME}_inline_ecc_defconfig"

IMXBOOT_TARGETS_NAND = "flash_singleboot_spinand flash_singleboot_spinand_fw"
IMXBOOT_TARGETS_FSPI = "flash_singleboot_flexspi"

IMXBOOT_TARGETS = "${@bb.utils.contains('UBOOT_CONFIG', 'nand', '${IMXBOOT_TARGETS_NAND}', \
                      bb.utils.contains('UBOOT_CONFIG', 'fspi', '${IMXBOOT_TARGETS_FSPI}', \
                                                                  'flash_singleboot', d), d)}"

DDR_FIRMWARE_NAME = " \
    lpddr4_dmem_1d_v202201.bin \
    lpddr4_dmem_2d_v202201.bin \
    lpddr4_imem_1d_v202201.bin \
    lpddr4_imem_2d_v202201.bin \
"

GLIBC_GENERATE_LOCALES = "zh_CN.UTF-8 en_GB.UTF-8 en_US.UTF-8"
DEFAULT_TIMEZONE="Asia/Shanghai"
IMAGE_LINGUAS = "zh-cn"
```

## meta-myir-bsp/conf/machine/myd-lmx9x-11x11.conf
```bitbake
require include/myir-lmx9x-evk.inc



KERNEL_DEVICETREE_BASENAME = "myd-lmx9x-11x11"
IMX_KERNEL_CONFIG_AARCH64 = "${KERNEL_DEVICETREE_BASENAME}_defconfig"
KERNEL_DEVICETREE:append:use-nxp-bsp = " \
 		myir/${KERNEL_DEVICETREE_BASENAME}.dtb \
		myir/${KERNEL_DEVICETREE_BASENAME}-lvds.dtb \
    myir/${KERNEL_DEVICETREE_BASENAME}-rgb.dtb \
 "

UBOOT_DTB_NAME = "${KERNEL_DEVICETREE_BASENAME}.dtb"
UBOOT_CONFIG ??= "sd_1g"


UBOOT_CONFIG[sd_1g]      = "${KERNEL_DEVICETREE_BASENAME}_1g_defconfig,sdcard"
UBOOT_CONFIG[sd_2g]      = "${KERNEL_DEVICETREE_BASENAME}_2g_defconfig,sdcard"

DDR_FIRMWARE_NAME = " \
    lpddr4_dmem_1d_v202201.bin \
    lpddr4_dmem_2d_v202201.bin \
    lpddr4_imem_1d_v202201.bin \
    lpddr4_imem_2d_v202201.bin \
"

WKS_FILE_DEPENDS:append:imx-nxp-bsp = " imx-m33-demos"
IMAGE_BOOT_FILES:append:imx-nxp-bsp = " \
    mcore-demos/imx93-11x11-evk_m33_TCM_rpmsg_lite_pingpong_rtos_linux_remote.bin \
    mcore-demos/imx93-11x11-evk_m33_TCM_rpmsg_lite_str_echo_rtos.bin \
    mcore-demos/imx93-11x11-evk_m33_TCM_sai_low_power_audio.bin \
"
```

## meta-myir-bsp/conf/machine/myd-lmx9x.conf
```bitbake
require include/myir-imx93-evk.inc

KERNEL_DEVICETREE_BASENAME = "myd-imx93-11x11"

KERNEL_DEVICETREE:append:use-nxp-bsp = " \
    myir/${KERNEL_DEVICETREE_BASENAME}-rgb.dtb \
 "


UBOOT_DTB_NAME = "myd-lmx93x-11x11"
UBOOT_CONFIG ??= "sd_1g"


DDR_FIRMWARE_NAME = " \
    lpddr4_dmem_1d_v202201.bin \
    lpddr4_dmem_2d_v202201.bin \
    lpddr4_imem_1d_v202201.bin \
    lpddr4_imem_2d_v202201.bin \
"

WKS_FILE_DEPENDS:append:imx-nxp-bsp = " imx-m33-demos"
IMAGE_BOOT_FILES:append:imx-nxp-bsp = " \
    mcore-demos/imx93-11x11-evk_m33_TCM_low_power_wakeword.bin \
    mcore-demos/imx93-11x11-evk_m33_TCM_power_mode_switch.bin \
    mcore-demos/imx93-11x11-evk_m33_TCM_rpmsg_lite_pingpong_rtos_linux_remote.bin \
    mcore-demos/imx93-11x11-evk_m33_TCM_rpmsg_lite_str_echo_rtos.bin \
    mcore-demos/imx93-11x11-evk_m33_TCM_sai_low_power_audio.bin \
"
```

## meta-myir-bsp/conf/machine/myd-y6ull-14x14-emmc.conf
```bitbake
#@TYPE: Machine
#@NAME: NXP i.MX6ULL 14x14 Evaluation Kit
#@SOC: i.MX6ULL
#@DESCRIPTION: Machine configuration for NXP i.MX6ULL 14x14 EVK
#@MAINTAINER: Lauren Post <lauren.post@nxp.com>

MACHINEOVERRIDES =. "mx6:mx6ul:mx6ull:"

include conf/machine/include/imx-base.inc
include conf/machine/include/arm/armv7a/tune-cortexa7.inc

KERNEL_DEVICETREE_BASENAME = "myd-y6ull-14x14"
KERNEL_DEVICETREE = " \
    myir/myd-y6ull/${KERNEL_DEVICETREE_BASENAME}-emmc.dtb \
    myir/myd-y6ull/${KERNEL_DEVICETREE_BASENAME}-emmc-ecspi.dtb \
"

#UBOOT_CONFIG ??= "${@bb.utils.contains('MACHINE_FEATURES', 'emmc', 'emmc', 'sd', d)}"
UBOOT_CONFIG ??= "${@bb.utils.contains('MACHINE_FEATURES', 'optee', 'sd-optee', \
                  bb.utils.contains('MACHINE_FEATURES', 'emmc', 'emmc', 'sd', d), d)}"
UBOOT_CONFIG[sd] = "mx6ull_14x14_evk_config,sdcard"
UBOOT_CONFIG[emmc] = "myd_imx6ull_emmc_defconfig,sdcard"
UBOOT_CONFIG[nand] = "mx6ull_14x14_evk_nand_config,ubifs"
UBOOT_CONFIG[qspi1] = "mx6ull_14x14_evk_qspi1_config"
UBOOT_CONFIG[sd-optee] = "myd_y6ull_emmc_optee_defconfig,sdcard"

OPTEE_BIN_EXT = "6ullevk"

MACHINE_FEATURES += "wifi bluetooth optee bcm4339 bcm43455"

IMAGE_FSTYPES:append = " tar.bz2 ext4"

DEFAULT_TIMEZONE = "Asia/Shanghai"

# HABv4 Secure Boot (i.MX6ULL)
DISTRO_FEATURES:append = " sec_boot"
MYIR_HAB_ENABLE = "${@bb.utils.contains('DISTRO_FEATURES', 'sec_boot', '1', '0', d)}"

MYIR_HAB_CST_DIR      = "${@bb.utils.contains('MYIR_HAB_ENABLE', '1', '${TOPDIR}/keys/cst', '', d)}"
MYIR_HAB_CST_CRYPTO      = "${@bb.utils.contains('MYIR_HAB_ENABLE', '1', 'rsa', '', d)}"
MYIR_HAB_CST_KEY_SIZE      = "${@bb.utils.contains('MYIR_HAB_ENABLE', '1', '2048', '', d)}"
MYIR_HAB_CST_DIG_ALGO      = "${@bb.utils.contains('MYIR_HAB_ENABLE', '1', 'sha256', '', d)}"
MYIR_HAB_CST_SRK_CA      = "${@bb.utils.contains('MYIR_HAB_ENABLE', '1', '1', '', d)}"
MYIR_HAB_CST_SRK_INDEX      = "${@bb.utils.contains('MYIR_HAB_ENABLE', '1', '1', '', d)}"


# HAB+TEE Boot Mode (i.MX6ULL)
# Uncomment one of the following to enable HAB+TEE boot:
#MYIR_HAB_TEE_MODE = "nonfit"
MYIR_HAB_TEE_MODE = "fit"

MYIR_FIT_ENABLE = "${@bb.utils.contains('MYIR_HAB_TEE_MODE', 'fit', '1', '0', d)}"

MYIR_KERNEL_HAB_SIGN = "${@bb.utils.contains('MYIR_HAB_TEE_MODE', 'nonfit', '1', '0', d)}"

# FIT Image (HABv4 secure boot)
KERNEL_IMAGETYPE:mx6ull-generic-bsp = "${@bb.utils.contains('MYIR_FIT_ENABLE', '1', 'fitImage', 'zImage', d)}"
MYIR_HABV4_FIT_SIGN_ENABLE = "${@bb.utils.contains('MYIR_FIT_ENABLE', '1', '1', '0', d)}"
MYIR_HAB_KERNEL_LOADADDR = "${@bb.utils.contains('MYIR_FIT_ENABLE', '1', '0x82000000', '0x80800000', d)}"
# FIT kernel load address must match OP-TEE CFG_NS_ENTRY_ADDR (0x80800000)
UBOOT_LOADADDRESS:mx6ull-generic-bsp = "${@bb.utils.contains('MACHINE_FEATURES', 'optee', '0x80800000', '0x80008000', d)}"
UBOOT_SIGN_ENABLE = "${@bb.utils.contains('MYIR_FIT_ENABLE', '1', '1', '0', d)}"
INHERIT += "${@bb.utils.contains('MYIR_HABV4_FIT_SIGN_ENABLE', '1', 'myir-fit-habv4-sign', '', d)}"

FIT_GENERATE_KEYS      = "${MYIR_FIT_ENABLE}"
UBOOT_SIGN_KEYDIR      = "${@bb.utils.contains('MYIR_FIT_ENABLE', '1', '${TOPDIR}/keys/fit', '', d)}"
UBOOT_SIGN_KEYNAME     = "${@bb.utils.contains('MYIR_FIT_ENABLE', '1', 'dev', '', d)}"
UBOOT_SIGN_IMG_KEYNAME = "${@bb.utils.contains('MYIR_FIT_ENABLE', '1', 'dev2', '', d)}"

# wic boot partition: use signed fitImage when HABv4 is enabled
IMAGE_BOOT_FILES:mx6ull-generic-bsp = " \
    ${@bb.utils.contains('MYIR_FIT_ENABLE', '1', 'fitImage-${MACHINE}-signed.bin;fitImage', '${KERNEL_IMAGETYPE}', d)} \
    ${@bb.utils.contains('MYIR_FIT_ENABLE', '1', '', '${@make_dtb_boot_files(d)}', d)} \
    ${@bb.utils.contains('MYIR_HAB_TEE_MODE', 'fit', '', bb.utils.contains('MACHINE_FEATURES', 'optee', '${OPTEE_BOOT_IMAGE}', '', d), d)} \
"

# WIC image with U-Boot environment at fixed MMC offsets
WKS_FILE = "${@bb.utils.contains('MACHINE_FEATURES', 'optee', 'myd-y6ull-14x14-emmc-signed.wks.in', '${MACHINE}.wks.in', d)}"
```
