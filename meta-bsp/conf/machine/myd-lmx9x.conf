## meta-myir-bsp/conf/machine/myd-y6ull-14x14-nand-512d.conf
```bitbake
#@TYPE: Machine
#@NAME: NXP i.MX6ULL 14x14 Evaluation Kit
#@SOC: i.MX6ULL
#@DESCRIPTION: Machine configuration for NXP i.MX6ULL 14x14 EVK
#@MAINTAINER: Lauren Post <lauren.post@nxp.com>

MACHINEOVERRIDES =. "mx6:mx6ul:mx6ull:"

include conf/machine/include/imx-base.inc
include conf/machine/include/arm/armv7a/tune-cortexa7.inc

KERNEL_DEVICETREE_BASENAME = "myd-y6ull-14x14-nand-ddr512"
KERNEL_DEVICETREE = " \
    myir/myd-y6ull/${KERNEL_DEVICETREE_BASENAME}.dtb \
    myir/myd-y6ull/${KERNEL_DEVICETREE_BASENAME}-ecspi.dtb \
"

UBOOT_CONFIG ??= "${@bb.utils.contains('MACHINE_FEATURES', 'nand', 'nand', 'sd', d)}"
UBOOT_CONFIG[sd] = "mx6ull_14x14_evk_config,sdcard"
UBOOT_CONFIG[emmc] = "mx6ull_14x14_evk_config,sdcard"
UBOOT_CONFIG[nand] = "myd_imx6ull_nand_ddr512_defconfig,ubifs"
UBOOT_CONFIG[qspi1] = "mx6ull_14x14_evk_qspi1_config"
UBOOT_CONFIG[sd-optee] = "mx6ull_14x14_evk_optee_config,sdcard"

OPTEE_BIN_EXT = "6ullevk"

MACHINE_FEATURES += "wifi bluetooth nand bcm4339 bcm43455"

IMAGE_FSTYPES:append = " tar.bz2 ubi"

DEFAULT_TIMEZONE = "Asia/Shanghai"

MKUBIFS_ARGS = "-F -m 4096 -e 253952 -c 6144"
UBINIZE_ARGS = "-m 4096 -p 256KiB -s 4096 -O 4096"

IMX_KERNEL_CONFIG_AARCH32 = "myd_y6ulx_defconfig"
```
